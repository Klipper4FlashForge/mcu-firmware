/* DATA VALIDATION ONLY. Not a bootable firmware layout.
 * Handler symbols resolve to measured stock Thumb addresses.
 * Lookup code is placed away from stock; code equality is not tested. */
SECTIONS
{
    .gd_generated_00002390 0x00002390 : { KEEP(*(.gd_generated_00002390)) }
    .gd_generated_0000239c 0x0000239c : { KEEP(*(.gd_generated_0000239c)) }
    .gd_generated_000023c0 0x000023c0 : { KEEP(*(.gd_generated_000023c0)) }
    .gd_generated_000023e8 0x000023e8 : { KEEP(*(.gd_generated_000023e8)) }
    .gd_generated_00002410 0x00002410 : { KEEP(*(.gd_generated_00002410)) }
    .gd_generated_00002738 0x00002738 : { KEEP(*(.gd_generated_00002738)) }
    .gd_generated_0000275c 0x0000275c : { KEEP(*(.gd_generated_0000275c)) }
    .gd_generated_0000276c 0x0000276c : { KEEP(*(.gd_generated_0000276c)) }
    .gd_generated_00002784 0x00002784 : { KEEP(*(.gd_generated_00002784)) }
    .gd_generated_00002794 0x00002794 : { KEEP(*(.gd_generated_00002794)) }
    .gd_generated_000027ac 0x000027ac : { KEEP(*(.gd_generated_000027ac)) }
    .gd_generated_00005d08 0x00005d08 : { KEEP(*(.gd_generated_00005d08)) }
    .gd_generated_00005d10 0x00005d10 : { KEEP(*(.gd_generated_00005d10)) }
    .gd_generated_00005d18 0x00005d18 : { KEEP(*(.gd_generated_00005d18)) }
    .gd_generated_00005d20 0x00005d20 : { KEEP(*(.gd_generated_00005d20)) }
    .gd_generated_00005d28 0x00005d28 : { KEEP(*(.gd_generated_00005d28)) }
    .gd_generated_00005d30 0x00005d30 : { KEEP(*(.gd_generated_00005d30)) }
    .gd_generated_00005d38 0x00005d38 : { KEEP(*(.gd_generated_00005d38)) }
    .gd_generated_00005d40 0x00005d40 : { KEEP(*(.gd_generated_00005d40)) }
    .gd_generated_00005d48 0x00005d48 : { KEEP(*(.gd_generated_00005d48)) }
    .gd_generated_00005d50 0x00005d50 : { KEEP(*(.gd_generated_00005d50)) }
    .gd_generated_00005d58 0x00005d58 : { KEEP(*(.gd_generated_00005d58)) }
    .gd_generated_00005d60 0x00005d60 : { KEEP(*(.gd_generated_00005d60)) }
    .gd_generated_00005d68 0x00005d68 : { KEEP(*(.gd_generated_00005d68)) }
    .gd_generated_00005d70 0x00005d70 : { KEEP(*(.gd_generated_00005d70)) }
    .gd_generated_00005d78 0x00005d78 : { KEEP(*(.gd_generated_00005d78)) }
    .gd_generated_00005d80 0x00005d80 : { KEEP(*(.gd_generated_00005d80)) }
    .gd_generated_00005d88 0x00005d88 : { KEEP(*(.gd_generated_00005d88)) }
    .gd_generated_00005d90 0x00005d90 : { KEEP(*(.gd_generated_00005d90)) }
    .gd_generated_00005d98 0x00005d98 : { KEEP(*(.gd_generated_00005d98)) }
    .gd_generated_0000655c 0x0000655c : { KEEP(*(.gd_generated_0000655c)) }
    .gd_generated_00006560 0x00006560 : { KEEP(*(.gd_generated_00006560)) }
    .gd_generated_00006880 0x00006880 : { KEEP(*(.gd_generated_00006880)) }
    .gd_generated_00006882 0x00006882 : { KEEP(*(.gd_generated_00006882)) }
    .gd_generated_00006883 0x00006883 : { KEEP(*(.gd_generated_00006883)) }
    .gd_generated_00006885 0x00006885 : { KEEP(*(.gd_generated_00006885)) }
    .gd_generated_00006889 0x00006889 : { KEEP(*(.gd_generated_00006889)) }
    .gd_generated_0000688d 0x0000688d : { KEEP(*(.gd_generated_0000688d)) }
    .gd_generated_00006890 0x00006890 : { KEEP(*(.gd_generated_00006890)) }
    .gd_generated_00006893 0x00006893 : { KEEP(*(.gd_generated_00006893)) }
    .gd_generated_00006895 0x00006895 : { KEEP(*(.gd_generated_00006895)) }
    .gd_generated_00006896 0x00006896 : { KEEP(*(.gd_generated_00006896)) }
    .gd_generated_00006899 0x00006899 : { KEEP(*(.gd_generated_00006899)) }
    .gd_generated_0000689b 0x0000689b : { KEEP(*(.gd_generated_0000689b)) }
    .gd_generated_0000689d 0x0000689d : { KEEP(*(.gd_generated_0000689d)) }
    .gd_generated_000068a2 0x000068a2 : { KEEP(*(.gd_generated_000068a2)) }
    .gd_generated_000068a5 0x000068a5 : { KEEP(*(.gd_generated_000068a5)) }
    .gd_generated_000068a9 0x000068a9 : { KEEP(*(.gd_generated_000068a9)) }
    .gd_generated_000068ae 0x000068ae : { KEEP(*(.gd_generated_000068ae)) }
    .gd_generated_000068b6 0x000068b6 : { KEEP(*(.gd_generated_000068b6)) }
    .gd_generated_000068b9 0x000068b9 : { KEEP(*(.gd_generated_000068b9)) }
    .gd_generated_000068bd 0x000068bd : { KEEP(*(.gd_generated_000068bd)) }
    .gd_generated_000068c5 0x000068c5 : { KEEP(*(.gd_generated_000068c5)) }
    .gd_generated_000068ca 0x000068ca : { KEEP(*(.gd_generated_000068ca)) }
    .gd_generated_000068cf 0x000068cf : { KEEP(*(.gd_generated_000068cf)) }
    .gd_generated_000068d2 0x000068d2 : { KEEP(*(.gd_generated_000068d2)) }
    .gd_generated_000068d7 0x000068d7 : { KEEP(*(.gd_generated_000068d7)) }
    .gd_generated_000068da 0x000068da : { KEEP(*(.gd_generated_000068da)) }
    .gd_generated_000068db 0x000068db : { KEEP(*(.gd_generated_000068db)) }
    .gd_generated_000068dd 0x000068dd : { KEEP(*(.gd_generated_000068dd)) }
    .gd_generated_000068df 0x000068df : { KEEP(*(.gd_generated_000068df)) }
    .gd_generated_000068e3 0x000068e3 : { KEEP(*(.gd_generated_000068e3)) }
    .gd_generated_000068e4 0x000068e4 : { KEEP(*(.gd_generated_000068e4)) }
    .gd_generated_000068f0 0x000068f0 : { KEEP(*(.gd_generated_000068f0)) }
    .gd_generated_0000692a 0x0000692a : { KEEP(*(.gd_generated_0000692a)) }
    .gd_generated_0000693d 0x0000693d : { KEEP(*(.gd_generated_0000693d)) }
    .gd_generated_00006951 0x00006951 : { KEEP(*(.gd_generated_00006951)) }
    .gd_generated_00006968 0x00006968 : { KEEP(*(.gd_generated_00006968)) }
    .gd_generated_0000697a 0x0000697a : { KEEP(*(.gd_generated_0000697a)) }
    .gd_generated_0000698b 0x0000698b : { KEEP(*(.gd_generated_0000698b)) }
    .gd_generated_0000699c 0x0000699c : { KEEP(*(.gd_generated_0000699c)) }
    .gd_generated_000069ad 0x000069ad : { KEEP(*(.gd_generated_000069ad)) }
    .gd_generated_000069dc 0x000069dc : { KEEP(*(.gd_generated_000069dc)) }
    .gd_generated_00006a01 0x00006a01 : { KEEP(*(.gd_generated_00006a01)) }
    .gd_generated_00006a29 0x00006a29 : { KEEP(*(.gd_generated_00006a29)) }
    .gd_generated_00006a43 0x00006a43 : { KEEP(*(.gd_generated_00006a43)) }
    .gd_generated_00006a7a 0x00006a7a : { KEEP(*(.gd_generated_00006a7a)) }
    .gd_generated_00006a99 0x00006a99 : { KEEP(*(.gd_generated_00006a99)) }
    .gd_generated_00006aad 0x00006aad : { KEEP(*(.gd_generated_00006aad)) }
    .gd_generated_00006ac3 0x00006ac3 : { KEEP(*(.gd_generated_00006ac3)) }
    .gd_generated_00006ad5 0x00006ad5 : { KEEP(*(.gd_generated_00006ad5)) }
    .gd_generated_00006b0a 0x00006b0a : { KEEP(*(.gd_generated_00006b0a)) }
    .gd_generated_00006b34 0x00006b34 : { KEEP(*(.gd_generated_00006b34)) }
    .gd_generated_00006b4c 0x00006b4c : { KEEP(*(.gd_generated_00006b4c)) }
    .gd_generated_00006b5a 0x00006b5a : { KEEP(*(.gd_generated_00006b5a)) }
    .gd_generated_00006b86 0x00006b86 : { KEEP(*(.gd_generated_00006b86)) }
    .gd_generated_00006bac 0x00006bac : { KEEP(*(.gd_generated_00006bac)) }
    .gd_generated_00006bbd 0x00006bbd : { KEEP(*(.gd_generated_00006bbd)) }
    .gd_generated_00006be9 0x00006be9 : { KEEP(*(.gd_generated_00006be9)) }
    .gd_generated_00006c0e 0x00006c0e : { KEEP(*(.gd_generated_00006c0e)) }
    .gd_generated_00006c2f 0x00006c2f : { KEEP(*(.gd_generated_00006c2f)) }
    .gd_generated_00006c4d 0x00006c4d : { KEEP(*(.gd_generated_00006c4d)) }
    .gd_generated_00006c65 0x00006c65 : { KEEP(*(.gd_generated_00006c65)) }
    .gd_generated_00006c75 0x00006c75 : { KEEP(*(.gd_generated_00006c75)) }
    .gd_generated_00006c87 0x00006c87 : { KEEP(*(.gd_generated_00006c87)) }
    .gd_generated_00006cc5 0x00006cc5 : { KEEP(*(.gd_generated_00006cc5)) }
    .gd_generated_00006cdd 0x00006cdd : { KEEP(*(.gd_generated_00006cdd)) }
    .gd_generated_00006cf1 0x00006cf1 : { KEEP(*(.gd_generated_00006cf1)) }
    .gd_generated_00006d10 0x00006d10 : { KEEP(*(.gd_generated_00006d10)) }
    .gd_generated_00006d46 0x00006d46 : { KEEP(*(.gd_generated_00006d46)) }
    .gd_generated_00006d75 0x00006d75 : { KEEP(*(.gd_generated_00006d75)) }
    .gd_generated_00006dae 0x00006dae : { KEEP(*(.gd_generated_00006dae)) }
    .text 0x10000000 : { *(.text*) }
    .ARM.exidx : { *(.ARM.exidx*) }
    /DISCARD/ : { *(.comment) *(.note*) }
}
PROVIDE(strcmp = 0x08000459);
PROVIDE(command_identify = 0x00001841);
PROVIDE(command_get_mcu_version = 0x00001779);
PROVIDE(command_get_basic_param = 0x00001691);
PROVIDE(command_pa_action = 0x00001a09);
PROVIDE(command_get_pa = 0x000017c1);
PROVIDE(command_remove_peel = 0x00001c19);
PROVIDE(command_clear_shutdown = 0x00000d11);
PROVIDE(command_emergency_stop = 0x000011c1);
PROVIDE(command_get_uptime = 0x000017f1);
PROVIDE(command_get_clock = 0x000016c9);
PROVIDE(command_finalize_config = 0x00001461);
PROVIDE(command_get_config = 0x000016f9);
PROVIDE(command_allocate_oids = 0x00000b31);
PROVIDE(command_debug_nop = 0x00000fa1);
PROVIDE(command_debug_ping = 0x00000fa9);
PROVIDE(command_debug_write = 0x00001029);
PROVIDE(command_debug_read = 0x00000fd9);
PROVIDE(command_set_digital_out = 0x00001ce1);
PROVIDE(command_update_digital_out = 0x00001f81);
PROVIDE(command_queue_digital_out = 0x00001a89);
PROVIDE(command_set_digital_out_pwm_cycle = 0x00001cf9);
PROVIDE(command_config_digital_out = 0x00000da9);
PROVIDE(command_stepper_stop_on_trigger = 0x00001e09);
PROVIDE(command_stepper_get_position = 0x00001da9);
PROVIDE(command_reset_step_clock = 0x00001c29);
PROVIDE(command_set_next_step_dir = 0x00001d71);
PROVIDE(command_queue_step = 0x00001b59);
PROVIDE(command_config_stepper = 0x00000f09);
PROVIDE(command_endstop_query_state = 0x000013d1);
PROVIDE(command_endstop_home = 0x00001361);
PROVIDE(command_config_endstop = 0x00000e09);
PROVIDE(command_trsync_trigger = 0x00001ee9);
PROVIDE(command_trsync_set_timeout = 0x00001e39);
PROVIDE(command_trsync_start = 0x00001e79);
PROVIDE(command_config_trsync = 0x00000f79);
PROVIDE(command_query_analog_in = 0x00001a29);
PROVIDE(command_config_analog_in = 0x00000d19);
PROVIDE(command_buttons_ack = 0x00000bb9);
PROVIDE(command_buttons_query = 0x00000c91);
PROVIDE(command_buttons_add = 0x00000c21);
PROVIDE(command_config_buttons = 0x00000d59);
PROVIDE(command_reset = 0x00001c21);
PROVIDE(command_mclib_set_resonance_damp = 0x000019a9);
PROVIDE(command_mclib_identify_motor = 0x00001901);
PROVIDE(command_mclib_set_pid_params = 0x00001961);
PROVIDE(command_mclib_set_current = 0x00001911);
PROVIDE(command_mclib_config_stalldetect = 0x000018d1);
PROVIDE(command_mclib_config_microstep = 0x000018a9);
PROVIDE(command_config_mclib = 0x00000e41);
